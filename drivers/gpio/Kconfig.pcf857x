## drivers/gpio/Kconfig.pcf857x
```kconfig
config GPIO_PCF857X
    bool "NXP PCF857x I2C GPIO expander"
    depends on GPIO && I2C
    help
      Enable support for the NXP PCF857x family of I2C-based GPIO expanders,
      such as the 8-bit PCF8574 and 16-bit PCF8575.
```

## dts/bindings/gpio/nxp,pcf857x.yaml
```yaml
# Copyright (c) 2022 ithinx GmbH
# SPDX-License-Identifier: Apache-2.0

description: NXP PCF857x I2C-based GPIO expander (PCF8574 / PCF8575)

compatible: "nxp,pcf857x"

include: [i2c-device.yaml, gpio-controller.yaml]

properties:
  ngpios:
    type: int
    required: true
    enum:
      - 8
      - 16
    description: Number of GPIOs provided by the expander

  int-gpios:
    type: phandle-array
    description: |
      GPIO connected to the controller INT pin. This pin is active-low.

  "#gpio-cells":
    const: 2

gpio-cells:
  - pin
  - flags
```
